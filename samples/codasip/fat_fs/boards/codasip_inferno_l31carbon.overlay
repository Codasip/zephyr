/*
 * Copyright (c) 2023 Codasip s.r.o.
 *
 * SPDX-License-Identifier: Apache-2.0
 */

&spi1 { /* SD Card */
        status = "okay";

        compatible = "codasip-xlnx,xps-spi-2.00.a";
        clock-frequency = <20000000>;

        sdhc0: sdhc@0 {
                compatible = "zephyr,sdhc-spi-slot";
                reg = <0>;
                spi-max-frequency = <20000000>;
                status = "okay";
                /* spi-clock-mode-cpol; */
                /* spi-clock-mode-cpha; */
                /* cd-gpios  = <&gpio01 0 GPIO_ACTIVE_LOW>; only for imx_usdhc.c */
                pwr-gpios = <&gpio01 1 GPIO_ACTIVE_LOW>;
                mmc {
                    compatible = "zephyr,sdmmc-disk";
                    status = "okay";
                };
        };
};
