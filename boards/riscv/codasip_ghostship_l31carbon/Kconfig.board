## boards/riscv/codasip_ghostship_l31carbon/Kconfig.board
```kconfig
# Copyright (c) 2023 Codasip s.r.o.
# SPDX-License-Identifier: Apache-2.0

config BOARD_CODASIP_GHOSTSHIP_L31CARBON
	bool "Board with Codasip RISC-V L31 Carbon CPU"
	depends on SOC_CODASIP_L31CARBON
```

## boards/riscv/codasip_ghostship_l31carbon/Kconfig.defconfig
```kconfig
# Copyright (c) 2023 Codasip s.r.o.
# SPDX-License-Identifier: Apache-2.0

if BOARD_CODASIP_GHOSTSHIP_L31CARBON

config BOARD
	default "ghostship-l31carbon"

endif # BOARD_CODASIP_GHOSTSHIP_L31CARBON
```

## boards/riscv/codasip_ghostship_l31helium/Kconfig.defconfig
```kconfig
# Copyright (c) 2023 Codasip s.r.o.
# SPDX-License-Identifier: Apache-2.0

if BOARD_CODASIP_GHOSTSHIP_L31HELIUM

config BOARD
	default "ghostship-l31helium"

endif # BOARD_CODASIP_GHOSTSHIP_L31HELIUM
```

## boards/riscv/codasip_hobbs_l110eagle/Kconfig.board
```kconfig
# Copyright (c) 2024 Codasip s.r.o.
# SPDX-License-Identifier: Apache-2.0

config BOARD_CODASIP_HOBBS_L110EAGLE
	bool "Hobbs Board with Codasip RISC-V L110 Eagle CPU"
	depends on SOC_CODASIP_L110EAGLE
```

## boards/riscv/codasip_hobbs_l110eagle/Kconfig.defconfig
```kconfig
# Copyright (c) 2024 Codasip s.r.o.
# SPDX-License-Identifier: Apache-2.0

if BOARD_CODASIP_HOBBS_L110EAGLE

config BOARD
	default "hobbs-l110eagle"

endif # BOARD_CODASIP_HOBBS_L110EAGLE
```

## boards/riscv/codasip_hobbs_l110eagle/codasip_hobbs_l110eagle_defconfig
```kconfig
#
# Copyright (c) 2024 Codasip s.r.o.
#
# SPDX-License-Identifier: Apache-2.0
#

CONFIG_SOC_SERIES_CODASIP_L110=y
CONFIG_SOC_CODASIP_L110EAGLE=y
CONFIG_BOARD_CODASIP_HOBBS_L110EAGLE=y
CONFIG_GPIO=y
CONFIG_SERIAL=y
CONFIG_CONSOLE=y
CONFIG_UART_CONSOLE=y
CONFIG_RISCV_SOC_INTERRUPT_INIT=y
CONFIG_XIP=n
CONFIG_CLOCK_CONTROL=n
CONFIG_HEAP_MEM_POOL_SIZE=4096
```

## boards/riscv/codasip_hobgoblin_a730/Kconfig.board
```kconfig
# Copyright (c) 2024 Codasip s.r.o.
# SPDX-License-Identifier: Apache-2.0

config BOARD_CODASIP_HOBGOBLIN_A730
	bool "Hobgoblin Board with Codasip RISC-V A730 CPU"
	depends on SOC_CODASIP_A730HOBGOBLIN
```

## boards/riscv/codasip_hobgoblin_a730/Kconfig.defconfig
```kconfig
# Copyright (c) 2024 Codasip s.r.o.
# SPDX-License-Identifier: Apache-2.0

if BOARD_CODASIP_HOBGOBLIN_A730

config BOARD
	default "hobgoblin-a730"

endif # BOARD_CODASIP_HOBGOBLIN_A730
```

## boards/riscv/codasip_hobgoblin_a730/codasip_hobgoblin_a730_defconfig
```kconfig
#
# Copyright (c) 2024 Codasip s.r.o.
#
# SPDX-License-Identifier: Apache-2.0
#

CONFIG_SOC_SERIES_CODASIP_730=y
CONFIG_SOC_CODASIP_A730=y
CONFIG_BOARD_CODASIP_HOBGOBLIN_A730=y
CONFIG_BASE64=y
CONFIG_GPIO=y
CONFIG_SERIAL=y
CONFIG_CONSOLE=y
CONFIG_UART_CONSOLE=y
CONFIG_RISCV_SOC_INTERRUPT_INIT=y
CONFIG_XIP=n
CONFIG_CLOCK_CONTROL=n
CONFIG_HEAP_MEM_POOL_SIZE=4096

# Required for Codasip 700 Series PMP as the minimum alignment is 4k
CONFIG_PMP_GRANULARITY=4096
```

## boards/riscv/codasip_hobgoblin_h730/Kconfig.board
```kconfig
# Copyright (c) 2024 Codasip s.r.o.
# SPDX-License-Identifier: Apache-2.0

config BOARD_CODASIP_HOBGOBLIN_H730
	bool "Hobgoblin Board with Codasip RISC-V H730 CPU"
	depends on SOC_CODASIP_H730HOBGOBLIN
```

## boards/riscv/codasip_hobgoblin_h730/Kconfig.defconfig
```kconfig
# Copyright (c) 2024 Codasip s.r.o.
# SPDX-License-Identifier: Apache-2.0

if BOARD_CODASIP_HOBGOBLIN_H730

config BOARD
	default "hobgoblin-h730"

endif # BOARD_CODASIP_HOBGOBLIN_H730
```

## boards/riscv/codasip_hobgoblin_h730/codasip_hobgoblin_h730_defconfig
```kconfig
#
# Copyright (c) 2024 Codasip s.r.o.
#
# SPDX-License-Identifier: Apache-2.0
#

CONFIG_SOC_SERIES_RISCV_CODASIP_700=y
CONFIG_SOC_CODASIP_H730HOBGOBLIN=y
CONFIG_BOARD_CODASIP_HOBGOBLIN_H730=y
CONFIG_BASE64=y
CONFIG_GPIO=y
CONFIG_SERIAL=y
CONFIG_CONSOLE=y
CONFIG_UART_CONSOLE=y
#CONFIG_UART_INTERRUPT_DRIVEN=y
CONFIG_RISCV_SOC_INTERRUPT_INIT=y
CONFIG_RISCV_HAS_PLIC=y
CONFIG_XIP=n
CONFIG_CLOCK_CONTROL=n
CONFIG_HEAP_MEM_POOL_SIZE=4096

# Required for Codasip 700 Series PMP as the minimum alignment is 4k
CONFIG_PMP_GRANULARITY=4096
```

## boards/riscv/codasip_hobgoblin_l110eagle/Kconfig.board
```kconfig
# Copyright (c) 2024 Codasip s.r.o.
# SPDX-License-Identifier: Apache-2.0

config BOARD_CODASIP_HOBGOBLIN_L110EAGLE
	bool "Hobgoblin Board with Codasip RISC-V L110 Eagle CPU"
	depends on SOC_CODASIP_L110EAGLE
```

## boards/riscv/codasip_hobgoblin_l110eagle/Kconfig.defconfig
```kconfig
# Copyright (c) 2024 Codasip s.r.o.
# SPDX-License-Identifier: Apache-2.0

if BOARD_CODASIP_HOBGOBLIN_L110EAGLE

config BOARD
	default "hobgoblin-l110eagle"

endif # BOARD_CODASIP_HOBGOBLIN_L110EAGLE
```

## boards/riscv/codasip_iiot_doombar_l31fluorine/Kconfig.board
```kconfig
# Copyright (c) 2023 Codasip s.r.o.
# SPDX-License-Identifier: Apache-2.0

config BOARD_CODASIP_IIOT_DOOMBAR_L31FLUORINE
	bool "Board with Codasip RISC-V Security L31 Carbon CPU"
	depends on SOC_CODASIP_L31FLUORINE
    select ENTROPY_GENERATOR
```

## boards/riscv/codasip_iiot_doombar_l31fluorine/Kconfig.defconfig
```kconfig
# Copyright (c) 2023 Codasip s.r.o.
# SPDX-License-Identifier: Apache-2.0

if BOARD_CODASIP_IIOT_DOOMBAR_L31FLUORINE

config BOARD
	default "iiot-doombar-l31fluorine"

endif # BOARD_CODASIP_IIOT_DOOMBAR_L31FLUORINE
```

## boards/riscv/codasip_iiot_rp_l31fluorine/Kconfig.defconfig
```kconfig
# Copyright (c) 2023 Codasip s.r.o.
# SPDX-License-Identifier: Apache-2.0

if BOARD_CODASIP_IIOT_RP_L31FLUORINE

config BOARD
	default "iiot-rp-l31fluorine"

endif # BOARD_CODASIP_IIOT_RP_L31FLUORINE
```

## boards/riscv/codasip_inferno_l31carbon/Kconfig.defconfig
```kconfig
# Copyright (c) 2023 Codasip s.r.o.
# SPDX-License-Identifier: Apache-2.0

if BOARD_CODASIP_INFERNO_L31CARBON

config BOARD
	default "inferno-l31carbon"

endif # BOARD_CODASIP_INFERNO_L31CARBON
```

## boards/riscv/codasip_inferno_l31helium/Kconfig.defconfig
```kconfig
# Copyright (c) 2023 Codasip s.r.o.
# SPDX-License-Identifier: Apache-2.0

if BOARD_CODASIP_INFERNO_L31HELIUM

config BOARD
	default "inferno_l31helium"

endif # BOARD_CODASIP_INFERNO_L31HELIUM
```

## boards/riscv/codasip_inferno_l31helium/codasip_inferno_l31helium_defconfig
```kconfig
#
# Copyright (c) 2023 Codasip s.r.o.
#
# SPDX-License-Identifier: Apache-2.0
#

CONFIG_SOC_SERIES_CODASIP_L31=y
CONFIG_SOC_CODASIP_L31HELIUM=y
CONFIG_BOARD_CODASIP_INFERNO_L31HELIUM=y
#CONFIG_GPIO=y
CONFIG_CONSOLE=y
CONFIG_SERIAL=y
CONFIG_UART_CONSOLE=y
#CONFIG_UART_INTERRUPT_DRIVEN=y
CONFIG_XIP=n
CONFIG_CLOCK_CONTROL=n
CONFIG_HEAP_MEM_POOL_SIZE=4096
```

## boards/riscv/codasip_l31carbon/Kconfig.defconfig
```kconfig
# Copyright (c) 2023 Codasip s.r.o.
# SPDX-License-Identifier: Apache-2.0

if BOARD_CODASIP_L31CARBON

config BOARD
	default "l31carbon"

endif # BOARD_CODASIP_L31CARBON
```

## boards/riscv/codasip_l31helium/Kconfig.defconfig
```kconfig
# Copyright (c) 2023 Codasip s.r.o.
# SPDX-License-Identifier: Apache-2.0

if BOARD_CODASIP_L31HELIUM

config BOARD
	default "l31helium"

endif # BOARD_CODASIP_L31HELIUM
```

## boards/riscv/codasip_l31iiot/codasip_l31iiot_defconfig
```kconfig
#
# Copyright (c) 2023 Codasip s.r.o.
#
# SPDX-License-Identifier: Apache-2.0
#

CONFIG_SOC_SERIES_RISCV_CODASIP_L31=y
CONFIG_SOC_CODASIP_L31CARBON=y
CONFIG_BOARD_CODASIP_L31IIOT=y
#CONFIG_GPIO=y
#CONFIG_SERIAL=y
CONFIG_CONSOLE=y
CONFIG_UART_CONSOLE=y
#CONFIG_UART_INTERRUPT_DRIVEN=y
CONFIG_XIP=n
CONFIG_CLOCK_CONTROL=n
CONFIG_ENTROPY_GENERATOR=y
CONFIG_HEAP_MEM_POOL_SIZE=4096
```

## boards/riscv/codasip_l31platformiiot/Kconfig.board
```kconfig
# Copyright (c) 2023 Codasip s.r.o.
# SPDX-License-Identifier: Apache-2.0

config BOARD_CODASIP_L31PLATFORMIIOT
	bool "Board with Codasip RISC-V Security L31 Carbon CPU"
	depends on SOC_CODASIP_L31CARBON
    select ENTROPY_GENERATOR
```

## boards/riscv/codasip_l31platformiiot/Kconfig.defconfig
```kconfig
# Copyright (c) 2023 Codasip s.r.o.
# SPDX-License-Identifier: Apache-2.0

if BOARD_CODASIP_L31PLATFORMIIOT

config BOARD
	default "l31platformiiot"

endif # BOARD_CODASIP_L31PLATFORMIIOT
```
