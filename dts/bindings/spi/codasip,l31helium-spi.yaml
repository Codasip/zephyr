## dts/bindings/spi/codasip,l31helium-spi.yaml
```yaml
# Copyright (c) 2023 Codasip s.r.o.
# SPDX-License-Identifier: Apache-2.0

description: |
  Codasip L31 Helium SPI controller.

compatible: "codasip,l31helium-spi"

include: [spi-controller.yaml]

properties:
  reg:
    required: true

  lines:
    type: int
    description: |
      QMSPI data lines 1, 2, or 4. 1 data line is full-duplex
      MOSI and MISO or half-duplex on MOSI only. Lines set to 2
      or 4 indicate dual or quad I/O modes.
      Defaults to 1 for full duplex driver's support for full-duplex spi.
    enum:
      - 1
      - 2
      - 4
```

## dts/bindings/watchdog/codasip,fpga-wdt-0-02.yaml
```yaml
# Copyright (c) Codasip s.r.o.
# SPDX-License-Identifier: Apache-2.0

description: Codasip Policy Manager Watchdog driver

compatible: "codasip,fpga-wdt-0_02"

include: base.yaml

properties:
  reg:
    required: true
  clock-frequency:
    type: int
    description: Wdt clock frequency in Hz
    required: true
```

## soc/riscv/codasip_700/Kconfig
```kconfig
# Copyright (c) 2024 Codasip s.r.o.
# SPDX-License-Identifier: Apache-2.0

config SOC_FAMILY_CODASIP_700
	bool

if SOC_FAMILY_CODASIP_700

config SOC_FAMILY
	string
	default "codasip_700"

source "soc/riscv/codasip_700/*/Kconfig.soc"

endif # SOC_FAMILY_CODASIP_700
```

## soc/riscv/codasip_700/Kconfig.soc
```kconfig
# Copyright (c) 2024 Codasip s.r.o.
# SPDX-License-Identifier: Apache-2.0

source "soc/riscv/codasip_700/*/Kconfig.series"
```

## soc/riscv/codasip_700/codasip_730/Kconfig.defconfig.730
```kconfig
# Copyright (c) 2024 Codasip s.r.o.
# SPDX-License-Identifier: Apache-2.0

####################################################################################################
# Common to all x730 Cores (on Hobgoblin FPGA Platform)
if SOC_CODASIP_A730 || SOC_CODASIP_H730
config SYS_CLOCK_HW_CYCLES_PER_SEC
    default 100000000   # Set to 100MHz for ACLINT to be accurate
#   default  25000000 the Core runs at 25MHz, but all the peripherials run at 100MHz, except SPI

config RISCV_SOC_INTERRUPT_INIT
    default y

config FPU
    default n # this should be y, but the link stage fails with: can't link soft-float modules with single-float modules

config GPIO
    default y

config SERIAL
    default y

##config RISCV_HAS_CLIC
##   default n
#
#config RISCV_HAS_PLIC
#    default y

config 2ND_LEVEL_INTERRUPTS
    default y

config 2ND_LVL_ISR_TBL_OFFSET
    default 12

config 2ND_LVL_INTR_00_OFFSET
    default 11

# Total number of interrupts (NUM_PIC_IRQS + 2ND_LVL_ISR_TBL_OFFSET)
config NUM_IRQS
    default 76

config SPI
    default y

config SPI_EXTENDED_MODES
    default y

endif # SOC_CODASIP_A730 || SOC_CODASIP_H730



####################################################################################################
# A730 specifics (MMU - not supported in Zephyr, no PMP)
if SOC_CODASIP_A730

config SOC
    default "codasip_a730"

# No PMP, only MMU which is not supported in Zephyr
#config RISCV_PMP
#    default y

#config PMP_SLOTS
#    default 16

endif # SOC_CODASIP_A730


####################################################################################################
# H730 specifics (no MMU, PMP 16)
if SOC_CODASIP_H730

config SOC
    default "codasip_h730"

config RISCV_PMP
    default y

config PMP_SLOTS
    default 16
    
endif # SOC_CODASIP_H730
```

## soc/riscv/codasip_700/codasip_730/Kconfig.defconfig.series
```kconfig
# Copyright (c) 2023 Codasip s.r.o.
# SPDX-License-Identifier: Apache-2.0

if SOC_SERIES_CODASIP_730

config SOC_SERIES
        default "codasip_730"

source "soc/riscv/codasip_700/codasip_730/Kconfig.defconfig.7*"

endif # SOC_SERIES_CODASIP_730
```

## soc/riscv/codasip_700/codasip_730/Kconfig.series
```kconfig
# SOC_SERIES_CODASIP_730 SOC implementation

# Copyright (c) 2024 Codasip s.r.o.
# SPDX-License-Identifier: Apache-2.0

config SOC_SERIES_CODASIP_730
	bool "Codasip 730 Series SOC implementation"
	select RISCV
    select RISCV_PRIVILEGED
    select RISCV_HAS_PLIC
    select SOC_FAMILY_CODASIP_700
	help
	  Enable support for Codasip 730 Series SOC
```

## soc/riscv/codasip_700/codasip_730/Kconfig.soc
```kconfig
# Copyright (c) 2024 Codasip s.r.o.
# SPDX-License-Identifier: Apache-2.0

choice
    prompt "Codasip 700 Series SOC implementation"
    depends on SOC_SERIES_CODASIP_730


####################################################################################################
config SOC_CODASIP_A730
    bool "Codasip RISC-V A730 (Obilix core)"
    select RISCV
    select ATOMIC_OPERATIONS_C
    select INCLUDE_RESET_VECTOR
    select 64BIT
    select RISCV_ISA_RV64I
    select RISCV_ISA_EXT_M
    select RISCV_ISA_EXT_A
    select RISCV_ISA_EXT_F
    select RISCV_ISA_EXT_D
    select RISCV_ISA_EXT_C

    select RISCV_ISA_EXT_ZICSR
    select RISCV_ISA_EXT_ZIFENCEI

# See: arch/riscv/Kconfig.isa
# Removed all the following to get Zephyr to link and run on QEMU
#   select RISCV_ISA_EXT_ZBA
#   select RISCV_ISA_EXT_ZBB
##   select RISCV_ISA_EXT_ZBC # Disabled in A730 Hobgoblin
#   select RISCV_ISA_EXT_ZBS
#   select RISCV_ISA_EXT_ZCB # Enabled in A730 Hobgoblin, but not in Zephyr at the moment


####################################################################################################
config SOC_CODASIP_H730
    bool "Codasip RISC-V H730 (Obilix core)"
    select RISCV
    select ATOMIC_OPERATIONS_C
    select INCLUDE_RESET_VECTOR
    select 64BIT
    select RISCV_ISA_RV64I
    select RISCV_ISA_EXT_M
    select RISCV_ISA_EXT_A
    select RISCV_ISA_EXT_F
    select RISCV_ISA_EXT_D
    select RISCV_ISA_EXT_C

    select RISCV_ISA_EXT_ZICSR
    select RISCV_ISA_EXT_ZIFENCEI

# See: arch/riscv/Kconfig.isa
# Removed all the following to get Zephyr to link and run on QEMU
#   select RISCV_ISA_EXT_ZBA
#   select RISCV_ISA_EXT_ZBB
##   select RISCV_ISA_EXT_ZBC # Disabled in A730 Hobgoblin
#   select RISCV_ISA_EXT_ZBS
#   select RISCV_ISA_EXT_ZCB # Enabled in A730 Hobgoblin, but not in Zephyr at the moment

endchoice
```

## soc/riscv/codasip_l100/Kconfig
```kconfig
# Copyright (c) 2024 Codasip s.r.o.
# SPDX-License-Identifier: Apache-2.0

config SOC_FAMILY_CODASIP_L100
	bool

if SOC_FAMILY_CODASIP_L100

config SOC_FAMILY
	string
	default "codasip_l100"

source "soc/riscv/codasip_l100/*/Kconfig.soc"

endif # SOC_FAMILY_CODASIP_L100
```

## soc/riscv/codasip_l100/codasip_l110/Kconfig.defconfig.l110eagle
```kconfig
# Copyright (c) 2024 Codasip s.r.o.
# SPDX-License-Identifier: Apache-2.0

if SOC_CODASIP_L110EAGLE

config SOC
    default "codasip-l110eagle"

config SYS_CLOCK_HW_CYCLES_PER_SEC
    default 50000000

config RISCV_SOC_INTERRUPT_INIT
    default y

config FPU
    default n
        
config GPIO
    default y

config SERIAL
    default y

config RISCV_HAS_CLIC
    default y

# CLIC changes mcause register by adding more Most Significant bits
# Now the Exception/interrupt code is only the lower 12 bits: Exccode[11:0]
# https://github.com/riscv/riscv-fast-interrupt/blob/5ef35cd40f809018a4a90b97fa0a7f5b4e150eba/clic.adoc#476-changes-to-xcause-csrs
config RISCV_MCAUSE_EXCEPTION_MASK
        default 0xFFF

#config RISCV_HAS_PLIC
#   default n

#config CODASIP_HAS_PIC
#   default n

#config 2ND_LEVEL_INTERRUPTS
#    default y

#config 2ND_LVL_ISR_TBL_OFFSET
#    default 12

#config 2ND_LVL_INTR_00_OFFSET
#    default 11

config RISCV_RESERVED_IRQ_ISR_TABLES_OFFSET
	default 0

config GEN_IRQ_VECTOR_TABLE
	default y

choice IRQ_VECTOR_TABLE_TYPE
	default IRQ_VECTOR_TABLE_JUMP_BY_ADDRESS
endchoice

config ARCH_SW_ISR_TABLE_ALIGN
	default 64

# Total number of interrupts NUM_CLIC_IRQS
config NUM_IRQS
    default 64

config RISCV_PMP
#   default n

config PMP_SLOTS
#   default 8

config SPI
    default y

config SPI_EXTENDED_MODES
    default y

endif # SOC_CODASIP_L110EAGLE
```

## soc/riscv/codasip_l100/codasip_l110/Kconfig.defconfig.series
```kconfig
# Copyright (c) 2024 Codasip s.r.o.
# SPDX-License-Identifier: Apache-2.0

if SOC_SERIES_CODASIP_L110

config SOC_SERIES
        default "codasip_l110"

source "soc/riscv/codasip_l100/codasip_l110/Kconfig.defconfig.l110*"

endif # SOC_SERIES_CODASIP_L110
```

## soc/riscv/codasip_l100/codasip_l110/Kconfig.series
```kconfig
# RISCV_CODASIP_L110 SOC implementation

# Copyright (c) 2024 Codasip s.r.o.
# SPDX-License-Identifier: Apache-2.0

config SOC_SERIES_CODASIP_L110
        bool "Codasip L110 SOC implementation"
        select RISCV
        select RISCV_PRIVILEGED
        select SOC_FAMILY_CODASIP_L100
        help
          Enable support for Codasip L110 SOC
```

## soc/riscv/codasip_l100/codasip_l110/Kconfig.soc
```kconfig
# Copyright (c) 2024 Codasip s.r.o.
# SPDX-License-Identifier: Apache-2.0

choice
    prompt "Codasip L100 SOC implementation"
    depends on SOC_SERIES_CODASIP_L110

####################################################################################################
config SOC_CODASIP_L110EAGLE
    bool "Codasip RISC-V L110 Eagle system implementation"
    select RISCV
    select ATOMIC_OPERATIONS_C
    select INCLUDE_RESET_VECTOR
    select RISCV_ISA_RV32I
    select RISCV_ISA_EXT_M
#   select RISCV_ISA_EXT_A        NOTE: L110 does not support atomic instructions
#   select RISCV_ISA_EXT_F
    select RISCV_ISA_EXT_C

    select RISCV_ISA_EXT_ZICSR
    select RISCV_ISA_EXT_ZIFENCEI

# See: arch/riscv/Kconfig.isa
    select RISCV_ISA_EXT_ZBA
    select RISCV_ISA_EXT_ZBB
#   select RISCV_ISA_EXT_ZBC
    select RISCV_ISA_EXT_ZBS

	select RISCV_VECTORED_MODE
	select GEN_IRQ_VECTOR_TABLE

####################################################################################################
config SOC_CODASIP_L110LYRA
    bool "Codasip RISC-V L110 Lyra system implementation"
    select RISCV
    select ATOMIC_OPERATIONS_C
    select INCLUDE_RESET_VECTOR
    select RISCV_ISA_RV32I
    select RISCV_ISA_EXT_M
#   select RISCV_ISA_EXT_A        NOTE: L110 does not support atomic instructions
#   select RISCV_ISA_EXT_F
    select RISCV_ISA_EXT_C

    select RISCV_ISA_EXT_ZICSR
    select RISCV_ISA_EXT_ZIFENCEI

# See: arch/riscv/Kconfig.isa
    select RISCV_ISA_EXT_ZBA
    select RISCV_ISA_EXT_ZBB
#   select RISCV_ISA_EXT_ZBC
    select RISCV_ISA_EXT_ZBS

	select RISCV_VECTORED_MODE
	select GEN_IRQ_VECTOR_TABLE

endchoice
```

## soc/riscv/codasip_l30/Kconfig
```kconfig
# Copyright (c) 2024 Codasip s.r.o.
# SPDX-License-Identifier: Apache-2.0

config SOC_FAMILY_CODASIP_L30
	bool

if SOC_FAMILY_CODASIP_L30

config SOC_FAMILY
	string
	default "codasip_l30"

source "soc/riscv/codasip_l30/*/Kconfig.soc"

endif # SOC_FAMILY_CODASIP_L30
```

## soc/riscv/codasip_l30/Kconfig.defconfig
```kconfig
# Copyright (c) 2024 Codasip s.r.o.
# SPDX-License-Identifier: Apache-2.0

source "soc/riscv/codasip_l30/*/Kconfig.defconfig.series"
```

## soc/riscv/codasip_l30/codasip_l31/Kconfig.defconfig.l31carbon
```kconfig
# Copyright (c) 2023 Codasip s.r.o.
# SPDX-License-Identifier: Apache-2.0

if SOC_CODASIP_L31CARBON

config SOC
    default "codasip_l31carbon"

config SYS_CLOCK_HW_CYCLES_PER_SEC
    default 25000000

config RISCV_SOC_INTERRUPT_INIT
    default y

config FPU
    default n

config GPIO
    default y

config SERIAL
    default y

#config RISCV_HAS_CLIC
#   default n

#config RISCV_HAS_PLIC
#   default n

config CODASIP_HAS_PIC
    default y

config NUM_PIC_IRQS
    int "Codasip PIC interrupt controller implementation"
    help
      Enable support for Codasip PIC interrupt controller
    default 32

config 2ND_LEVEL_INTERRUPTS
    default y

config 2ND_LVL_ISR_TBL_OFFSET
    default 12

config 2ND_LVL_INTR_00_OFFSET
    default 11

# Total number of interrupts (NUM_PIC_IRQS + 2ND_LVL_ISR_TBL_OFFSET)
config NUM_IRQS
    default 44

config RISCV_PMP
    default y

config PMP_SLOTS
    default 8

config SPI
    default y

config SPI_EXTENDED_MODES
    default y

endif # SOC_CODASIP_L31CARBON
```

## soc/riscv/codasip_l30/codasip_l31/Kconfig.defconfig.series
```kconfig
# Copyright (c) 2023 Codasip s.r.o.
# SPDX-License-Identifier: Apache-2.0

if SOC_SERIES_CODASIP_L31

config SOC_SERIES
        default "codasip_l31"

source "soc/riscv/codasip_l30/codasip_l31/Kconfig.defconfig.l31*"

endif # SOC_SERIES_CODASIP_L31
```

## soc/riscv/codasip_l30/codasip_l31/Kconfig.series
```kconfig
# RISCV_CODASIP_L31 SOC implementation

# Copyright (c) 2024 Codasip s.r.o.
# SPDX-License-Identifier: Apache-2.0

config SOC_SERIES_CODASIP_L31
        bool "Codasip L31 SOC implementation"
        select RISCV
        select RISCV_PRIVILEGED
        select SOC_FAMILY_CODASIP_L30
        help
          Enable support for Codasip L31 SOC
```

## soc/riscv/codasip_l30/codasip_l31/Kconfig.soc
```kconfig
# Copyright (c) 2024 Codasip s.r.o.
# SPDX-License-Identifier: Apache-2.0

choice
    prompt "Codasip L31 Carbon SOC implementation"
    depends on SOC_SERIES_CODASIP_L31


####################################################################################################
config SOC_CODASIP_L31CARBON
    bool "Codasip RISC-V L31 Carbon system implementation"
    select RISCV
    select ATOMIC_OPERATIONS_C
    select INCLUDE_RESET_VECTOR
    select RISCV_ISA_RV32I
    select RISCV_ISA_EXT_M
#   select RISCV_ISA_EXT_A        NOTE: L31 does not support atomic instructions
#   select RISCV_ISA_EXT_F
    select RISCV_ISA_EXT_C

    select RISCV_ISA_EXT_ZICSR
    select RISCV_ISA_EXT_ZIFENCEI

# See: arch/riscv/Kconfig.isa
    select RISCV_ISA_EXT_ZBA
    select RISCV_ISA_EXT_ZBB
    select RISCV_ISA_EXT_ZBC
    select RISCV_ISA_EXT_ZBS



####################################################################################################
config SOC_CODASIP_L31HELIUM
    bool "Codasip RISC-V L31 Helium system implementation"
    select RISCV
    select ATOMIC_OPERATIONS_C
    select INCLUDE_RESET_VECTOR
    select RISCV_ISA_RV32I
    select RISCV_ISA_EXT_M
#   select RISCV_ISA_EXT_A        NOTE: L31 does not support atomic instructions
    select RISCV_ISA_EXT_F
    select RISCV_ISA_EXT_C

    select RISCV_ISA_EXT_ZICSR
    select RISCV_ISA_EXT_ZIFENCEI

# See: arch/riscv/Kconfig.isa
    select RISCV_ISA_EXT_ZBA
    select RISCV_ISA_EXT_ZBB
    select RISCV_ISA_EXT_ZBC
    select RISCV_ISA_EXT_ZBS



####################################################################################################
config SOC_CODASIP_L31FLUORINE
    bool "Codasip RISC-V L31 Fluorine system implementation"
    select RISCV
    select ATOMIC_OPERATIONS_C
    select INCLUDE_RESET_VECTOR
    select RISCV_ISA_RV32I
    select RISCV_ISA_EXT_M
#   select RISCV_ISA_EXT_A        NOTE: L31 does not support atomic instructions
#   select RISCV_ISA_EXT_F
    select RISCV_ISA_EXT_C

    select RISCV_ISA_EXT_ZICSR
    select RISCV_ISA_EXT_ZIFENCEI

# See: arch/riscv/Kconfig.isa
    select RISCV_ISA_EXT_ZBA
    select RISCV_ISA_EXT_ZBB
    select RISCV_ISA_EXT_ZBC
    select RISCV_ISA_EXT_ZBS


endchoice
```

## soc/riscv/riscv-privilege/codasip/Kconfig.defconfig.series
```kconfig
# Copyright (c) 2023 Codasip s.r.o.
# SPDX-License-Identifier: Apache-2.0

#SOC_CODASIP_L31HELIUM

if SOC_SERIES_RISCV_CODASIP_L31

config SOC_SERIES
	default "codasip"

endif # SOC_SERIES_RISCV_CODASIP_L31
```

## soc/riscv/riscv-privilege/codasip/Kconfig.series
```kconfig
# RISCV_CODASIP_L31 SOC implementation

# Copyright (c) 2023 Codasip s.r.o.
# SPDX-License-Identifier: Apache-2.0

config SOC_SERIES_RISCV_CODASIP_L31
	bool "Codasip L31 SOC implementation"
	select RISCV
	select SOC_FAMILY_RISCV_PRIVILEGE
	help
	  Enable support for Codasip L31 SOC
```
