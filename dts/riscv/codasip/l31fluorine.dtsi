/*
 * Copyright (c) 2023 Codasip s.r.o.
 *
 * SPDX-License-Identifier: Apache-2.0
 */

/* See: https://docs.zephyrproject.org/latest/hardware/porting/board_porting.html */

/* Codasip Fluorine L31AS Security Core (functionally the same as Carbon from a software perspective) */

#include <codasip/l31carbon.dtsi>

/ {
        soc {
                compatible = "codasip,l31fluorine";
        };
};
