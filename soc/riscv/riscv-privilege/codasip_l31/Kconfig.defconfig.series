## soc/riscv/riscv-privilege/codasip_l31/Kconfig.defconfig.series
```kconfig
# Copyright (c) 2023 Codasip s.r.o.
# SPDX-License-Identifier: Apache-2.0

if SOC_SERIES_RISCV_CODASIP_L31

config SOC_SERIES
	default "codasip_l31"

endif # SOC_SERIES_RISCV_CODASIP_L31
```
