## drivers/crypto/Kconfig.codasip_aead
```kconfig
# Codasip AEAD configuration options

# Copyright (c) 2024 Codasip s.r.o.
# SPDX-License-Identifier: Apache-2.0

config CRYPTO_CODASIP_AEAD_ADAPTOR
	bool "Codasip AEAD Adaptor"
	default y
    depends on DT_HAS_CODASIP_AEAD_ADAPTOR_ENABLED
	help
	  Enable Codasip AEAD Adaptor encryption driver
```

## drivers/entropy/Kconfig.codasip_fpga_0_1
```kconfig
# Codasip L31 FPGA SPI Driver configuration options

# Copyright (c) 2023 Codasip s.r.o.
# SPDX-License-Identifier: Apache-2.0

config ENTROPY_CODASIP_FPGA_TRNG_0_1
        bool "Codasip FPGA TRNG (revision 0.1) controller driver"
        default y
        depends on DT_HAS_CODASIP_FPGA_TRNG_0_1_ENABLED
        select ENTROPY_HAS_DRIVER
        help
          Enable the TRNG peripherals on Codasip FPGA SOC
```

## drivers/gpio/Kconfig.codasip_fpga_1_1
```kconfig
# Codacip L31 Helium GPIO configuration options

# Copyright (c) 2023 Codasip s.r.o.
# SPDX-License-Identifier: Apache-2.0

config GPIO_CODASIP_FPGA_1_1
    bool "Codasip FPGA GPIO (revision 1.1) driver"
    default y
    depends on DT_HAS_CODASIP_FPGA_GPIO_1_1_ENABLED
    help
      Enable the GPIO peripherals on Codasip FPGA SOC.
```

## drivers/gpio/Kconfig.l31helium
```kconfig
# Codacip L31 Helium GPIO configuration options

# Copyright (c) 2023 Codasip s.r.o.
# SPDX-License-Identifier: Apache-2.0

config GPIO_L31HELIUM
	bool "L31 Helium GPIO driver"
	default y
	depends on DT_HAS_CODASIP_L31HELIUM_GPIO_ENABLED
	help
	  Enable Codasip L31 Helium GPIO driver.
```

## drivers/interrupt_controller/Kconfig.clic
```kconfig
# Copyright (c) 2021 Tokita, Hiroshi <tokita.hiroshi@gmail.com>
# SPDX-License-Identifier: Apache-2.0

config CODASIP_CLIC
	bool "Codasip Core Local Interrupt Controller (CLIC)"
	default y
	depends on DT_HAS_CODASIP_CLIC_ENABLED
#	select MULTI_LEVEL_INTERRUPTS
	select RISCV_SOC_HAS_CUSTOM_IRQ_HANDLING if !RISCV_VECTORED_MODE
	help
	  Interrupt controller for Codasip SoC core.

config NUCLEI_ECLIC
	bool "Enhanced Core Local Interrupt Controller (ECLIC)"
	default y
	depends on DT_HAS_NUCLEI_ECLIC_ENABLED
	select MULTI_LEVEL_INTERRUPTS
	select RISCV_SOC_HAS_CUSTOM_IRQ_HANDLING if !RISCV_VECTORED_MODE
	help
	  Interrupt controller for Nuclei SoC core.

config LEGACY_CLIC
	bool "Use the legacy clic specification"
	depends on RISCV_HAS_CLIC
	help
	  Enables legacy clic, where smclicshv extension is not supported and
	  hardware vectoring is set via mode bits of mtvec.
```

## drivers/interrupt_controller/Kconfig.codasip_fpga_pic
```kconfig
# Copyright (c) 2023 Codasip s.r.o.
# SPDX-License-Identifier: Apache-2.0

config CODASIP_FPGA_PIC
    bool "Codasip FPGA Programmable Interrupt Controller (PIC)"
    default y
    depends on DT_HAS_CODASIP_FPGA_PIC_ENABLED
    select MULTI_LEVEL_INTERRUPTS
    select 2ND_LEVEL_INTERRUPTS
    help
      Codasip FPGA Programmable Interrupt Controller provides support
      for external interrupt lines.
```

## drivers/interrupt_controller/Kconfig.codasip_pic
```kconfig
# Copyright (c) 2023 Codasip s.r.o.
# SPDX-License-Identifier: Apache-2.0

config CODASIP_PIC
	bool "Codasip Peripheral Interrupt Controller (PIC)"
	default y
	depends on DT_HAS_CODASIP_PIC_ENABLED
	select MULTI_LEVEL_INTERRUPTS
	select 2ND_LEVEL_INTERRUPTS
	help
	  Codasip Perpherial Interrupt Controller provides support
	  for external interrupt lines.

# OLD:	depends on DT_HAS_SIFIVE_PLIC_1_0_0_ENABLED
```

## drivers/policy_mngr/Kconfig
```kconfig
# Codasip Policy Manager configuration options

# Copyright (c) 2023 Codasip s.r.o.
# SPDX-License-Identifier: Apache-2.0

menuconfig POLICY_MNGR
	bool "Policy Manager drivers"
	help
	  Codasip IIOT policy alarm manager.

if POLICY_MNGR

module = POLICY_MNGR
module-str = policy_manager
source "subsys/logging/Kconfig.template.log_config"

source "drivers/policy_mngr/Kconfig.codasip_0_02"

endif # POLICY_MNGR
```

## drivers/policy_mngr/Kconfig.codasip_0_02
```kconfig
# Policy Manager configuration options
#
# Copyright (C) 2023 Codasip s.r.o.
#
# SPDX-License-Identifier: Apache-2.0

config POLICY_MNGR_CODASIP_0_02
	bool "Codasip Policy Manager Driver"
	depends on DT_HAS_CODASIP_POLICY_MNGR_0_02_ENABLED
	default y
	help
	  Enable Policy Manager driver for Codasip MCUs
```

## drivers/policy_mngr/Kconfig.codasip_fpga_0_02
```kconfig
# Policy Manager configuration options
#
# Copyright (C) 2023 Codasip s.r.o.
#
# SPDX-License-Identifier: Apache-2.0

config POLICY_MNGR_CODASIP_FPGA_0_02
	bool "Codasip Policy Manager Driver"
	depends on DT_HAS_CODASIP_FPGA_POLICY_MNGR_0_02_ENABLED
	default y
	help
	  Enable Policy Mangaer driver for Codasip MCUs
```

## drivers/spi/Kconfig.codasip_fpga_1_1
```kconfig
# Codasip L31 Helium SPI Driver configuration options

# Copyright (c) 2023 Codasip s.r.o.
# SPDX-License-Identifier: Apache-2.0

config SPI_CODASIP_FPGA_1_1
        bool "Codasip FPGA SPI (revision 1.1) controller driver"
        default y
        depends on DT_HAS_CODASIP_FPGA_SPI_1_1_ENABLED
        help
          Enable the SPI peripherals on Codasip FPGA SOC
```

## drivers/spi/Kconfig.codasip_l31helium
```kconfig
# Codasip L31 Helium SPI Driver configuration options

# Copyright (c) 2023 Codasip s.r.o.
# SPDX-License-Identifier: Apache-2.0

config SPI_CODASIP_L31HELIUM
        bool "Codasip L31 Helium SPI controller driver"
        default y
        depends on DT_HAS_CODASIP_L31HELIUM_SPI_ENABLED
        help
          Enable the SPI peripherals on Codasip L31 Helium SOC
```

## drivers/spi/Kconfig.codasip_xlnx
```kconfig
# Xilinx SPI

# Copyright (c) 2020 Henrik Brix Andersen <henrik@brixandersen.dk>
# Copyright (c) 2023 Codasip s.r.o.
# SPDX-License-Identifier: Apache-2.0

config SPI_CODASIP_XLNX_AXI_QUADSPI
	bool "Xilinx AXI Quad SPI driver with modification for Codasip FPGA"
	default y
	depends on DT_HAS_CODASIP_XLNX_XPS_SPI_2_00_A_ENABLED
	help
	  Enable Xilinx AXI Quad SPI v3.2 driver with modifications for Codasip FPGA.
```

## drivers/watchdog/Kconfig.codasip_0_02
```kconfig
# Watchdog configuration options
#
# Copyright (C) 2023 Codasip s.r.o.
#
# SPDX-License-Identifier: Apache-2.0

config WDT_CODASIP_0_02
    bool "Codasip Policy Manager Watchdog Driver"
    depends on DT_HAS_CODASIP_WDT_0_02_ENABLED
    default y
    help
      Enable Watchdog driver for Codasip MCUs
```

## dts/bindings/cpu/codasip,a730.yaml
```yaml
# Copyright (c) 2024 Codasip s.r.o.
# SPDX-License-Identifier: Apache-2.0

description: This is a representation of Codasip A730 CPU.

compatible: "codasip,a730"

include: cpu.yaml
```

## dts/bindings/cpu/codasip,h730.yaml
```yaml
# Copyright (c) 2024 Codasip s.r.o.
# SPDX-License-Identifier: Apache-2.0

description: This is a representation of Codasip H730 CPU.

compatible: "codasip,h730"

include: cpu.yaml
```

## dts/bindings/cpu/codasip,l31fluorine.yaml
```yaml
# Copyright (c) 2023 Codasip s.r.o.
# SPDX-License-Identifier: Apache-2.0

description: This is a representation of Codasip L31AS Security CPU.

compatible: "codasip,l31fluorine"

include: cpu.yaml
```

## dts/bindings/cpu/codasip,l31helium.yaml
```yaml
# Copyright (c) 2023 Codasip s.r.o.
# SPDX-License-Identifier: Apache-2.0

description: This is a representation of Codasip L31 CPU.

compatible: "codasip,l31helium"

include: cpu.yaml
```

## dts/bindings/crypto/codasip,aead-adaptor.yaml
```yaml
# Copyright (c) 2024 Codasip s.r.o.
# SPDX-License-Identifier: Apache-2.0

description: Codasip AEAD Adaptor

compatible: "codasip,aead-adaptor"

include: base.yaml

properties:
  reg:
    required: true
  algo:
    type: int
    required: true
    description: Crypto Algorithm
  mode:
    type: int
    description: Crypto Algorithm Mode (not all crypto algorithms have a mode)
```

## dts/bindings/gpio/codasip,fpga-gpio-1_1.yaml
```yaml
# SPDX-License-Identifier: Apache-2.0

description: Codasip FPGA GPIO controller.

compatible: "codasip,fpga-gpio-1_1"

include: [gpio-controller.yaml, base.yaml]

properties:
  reg:
    required: true

  interrupts:
    required: false

  "#gpio-cells":
    const: 2

gpio-cells:
  - pin
  - flags
```

## dts/bindings/gpio/codasip,l31helium-gpio.yaml
```yaml
# SPDX-License-Identifier: Apache-2.0

description: Codasip L31 Helium GPIO node

compatible: "codasip,l31helium-gpio"

include: [gpio-controller.yaml, base.yaml]

properties:
  reg:
    required: true

  interrupts:
    required: false

  "#gpio-cells":
    const: 2

gpio-cells:
  - pin
  - flags
```

## dts/bindings/interrupt-controller/codasip,pic.yaml
```yaml
# Copyright (c) 2023 Codasip s.r.o.
# SPDX-License-Identifier: Apache-2.0

description: Codasip peripheral interrupt controller

compatible: "codasip,pic"

include: [interrupt-controller.yaml, base.yaml]

properties:
  reg:
    required: true

  "#interrupt-cells":
    const: 1

interrupt-cells:
  - irq

properties:
  codasip-pic,ndev:
    type: int
    description: Number of external interrupts supported
    required: true
```

## dts/bindings/policy_mngr/codasip,fpga-policy-mngr-0-02.yaml
```yaml
# Copyright (c) Codasip s.r.o.
# SPDX-License-Identifier: Apache-2.0

description: Codasip Policy Manager Watchdog driver

compatible: "codasip,fpga-policy-mngr-0_02"

include: base.yaml

properties:
  reg:
    required: true
  clock-frequency:
    type: int
    description: Wdt clock frequency in Hz
    required: true
  nalarms:
    type: int
    default: 32
    description: |
        This property indicates the number of in-use slots of available slots
        for alarms. The typical example is something like this: the hardware
        register is 32 bits wide, but only 3 of the bits have a physical
        counterpart. The driver is generally written so that all 32 bits can
        be used, but the IP block is reused in a lot of designs, some using
        all 32 bits, some using 3 and some using 12. In this case, setting
        "nalarms = <3>;" informs the driver that only the first 3 alarms, at
        local offset 0 .. 2, are in use.  For cases in which there might be
        holes in the slot range, this value should be the max slot number+1.
```

## dts/bindings/rng/codasip,fpga-trng-0_1.yaml
```yaml
# Copyright (c) 2019 Brett Witherspoon
# SPDX-License-Identifier: Apache-2.0

description: Codasip FPGA TRNG (True Random Number Generator)

compatible: "codasip,fpga-trng-0_1"

include: base.yaml

properties:
  reg:
    required: true
```

## dts/bindings/rng/codasip,trng-0_1.yaml
```yaml
# Copyright (c) 2019 Brett Witherspoon
# SPDX-License-Identifier: Apache-2.0

description: Codasip TRNG (True Random Number Generator)

compatible: "codasip,trng-0_1"

include: base.yaml

properties:
  reg:
    required: true
```
